// gpio-http — universal ESP32 GPIO control over HTTP (arduino-esp32 3.x)
//
// Endpoints (all require "Authorization: Bearer <token>" if a token is set):
//   GET  /api/gpio          chip info + all pins with capabilities and state
//   GET  /api/gpio/{pin}    one pin
//   POST /api/gpio          {"pin": 4, "level": "high"} and/or {"pin": 4, "mode": "input_pullup"}
//   GET  /api/profile       current board profile
//   PUT  /api/profile       {"reserve": [21], "release": [1, 3], "labels": {"4": "D4"}}

#include <WiFi.h>
#include <WebServer.h>
#include <uri/UriBraces.h>
#include <WiFiManager.h>
#include <ArduinoJson.h>
#include <Preferences.h>
#include "soc/soc_caps.h"
#include "driver/gpio.h"
#include "esp_adc/adc_oneshot.h"
#if SOC_RTCIO_PIN_COUNT > 0
#include "driver/rtc_io.h"
#endif

#if __has_include("version.h")
#include "version.h"  // generated by the release workflow
#endif
#ifndef FW_VERSION
#define FW_VERSION "dev"
#endif

static constexpr uint8_t NO_PIN = 0xFF;  // list terminator

// ---- Chip-specific tables ---------------------------------------------------
// STRAPPING: usable, but their level at reset affects boot mode.
// RESERVED: default reservations — SPI flash, native USB, UART0 (Serial).
// RESERVED_PSRAM: only applied when PSRAM is detected.
// These are best-effort for common modules; a board profile can override them.
#if CONFIG_IDF_TARGET_ESP32
static const uint8_t STRAPPING[]     = {0, 2, 5, 12, 15, NO_PIN};
static const uint8_t RESERVED[]      = {1, 3, 6, 7, 8, 9, 10, 11, NO_PIN};
static const uint8_t RESERVED_PSRAM[] = {16, 17, NO_PIN};
#elif CONFIG_IDF_TARGET_ESP32S2
static const uint8_t STRAPPING[]     = {0, 45, 46, NO_PIN};
static const uint8_t RESERVED[]      = {19, 20, 26, 27, 28, 29, 30, 31, 32, 43, 44, NO_PIN};
static const uint8_t RESERVED_PSRAM[] = {NO_PIN};
#elif CONFIG_IDF_TARGET_ESP32S3
static const uint8_t STRAPPING[]     = {0, 3, 45, 46, NO_PIN};
static const uint8_t RESERVED[]      = {19, 20, 26, 27, 28, 29, 30, 31, 32, 43, 44, NO_PIN};
static const uint8_t RESERVED_PSRAM[] = {33, 34, 35, 36, 37, NO_PIN};  // octal PSRAM modules only; release via profile if quad
#elif CONFIG_IDF_TARGET_ESP32C3
static const uint8_t STRAPPING[]     = {2, 8, 9, NO_PIN};
static const uint8_t RESERVED[]      = {11, 12, 13, 14, 15, 16, 17, 18, 19, 20, 21, NO_PIN};
static const uint8_t RESERVED_PSRAM[] = {NO_PIN};
#elif CONFIG_IDF_TARGET_ESP32C6
static const uint8_t STRAPPING[]     = {4, 5, 8, 9, 15, NO_PIN};
static const uint8_t RESERVED[]      = {12, 13, 16, 17, 24, 25, 26, 27, 28, 29, 30, NO_PIN};
static const uint8_t RESERVED_PSRAM[] = {NO_PIN};
#else
#error "Unsupported target: add STRAPPING/RESERVED tables for this chip"
#endif

// ---- State --------------------------------------------------------------------
enum GpioMode : uint8_t { GM_UNSET, GM_INPUT, GM_INPUT_PULLUP, GM_INPUT_PULLDOWN, GM_OUTPUT };

struct PinState {
  GpioMode mode = GM_UNSET;
  bool reserved = false;
  String label;
};

WebServer server(80);
Preferences prefs;
String apiToken;
PinState pins[SOC_GPIO_PIN_COUNT];

// ---- Helpers ------------------------------------------------------------------
static bool inList(const uint8_t *list, int p) {
  for (; *list != NO_PIN; list++)
    if (*list == p) return true;
  return false;
}

static bool pinExists(int p) {
  return p >= 0 && p < SOC_GPIO_PIN_COUNT && ((SOC_GPIO_VALID_GPIO_MASK >> p) & 1ULL);
}

static bool pinCanOutput(int p) {
  return pinExists(p) && ((SOC_GPIO_VALID_OUTPUT_GPIO_MASK >> p) & 1ULL);
}

static const char *modeName(GpioMode m) {
  switch (m) {
    case GM_INPUT: return "input";
    case GM_INPUT_PULLUP: return "input_pullup";
    case GM_INPUT_PULLDOWN: return "input_pulldown";
    case GM_OUTPUT: return "output";
    default: return "unset";
  }
}

static GpioMode parseMode(JsonVariantConst v) {
  const char *s = v.as<const char *>();
  if (!s) return GM_UNSET;
  if (!strcasecmp(s, "input")) return GM_INPUT;
  if (!strcasecmp(s, "input_pullup")) return GM_INPUT_PULLUP;
  if (!strcasecmp(s, "input_pulldown")) return GM_INPUT_PULLDOWN;
  if (!strcasecmp(s, "output")) return GM_OUTPUT;
  return GM_UNSET;
}

static int parseLevel(JsonVariantConst v) {
  if (v.is<bool>()) return v.as<bool>() ? 1 : 0;
  if (v.is<int>()) {
    int i = v.as<int>();
    return (i == 0 || i == 1) ? i : -1;
  }
  if (v.is<const char *>()) {
    const char *s = v.as<const char *>();
    if (!strcasecmp(s, "high")) return 1;
    if (!strcasecmp(s, "low")) return 0;
  }
  return -1;
}

static void pinToJson(int p, JsonObject o) {
  o["pin"] = p;
  if (pins[p].label.length()) o["label"] = pins[p].label;

  JsonArray caps = o["caps"].to<JsonArray>();
  caps.add("input");
  if (pinCanOutput(p)) caps.add("output");
  adc_unit_t unit;
  adc_channel_t ch;
  if (adc_oneshot_io_to_channel(p, &unit, &ch) == ESP_OK)
    caps.add(unit == ADC_UNIT_1 ? "adc1" : "adc2");
#if SOC_TOUCH_SENSOR_SUPPORTED
  if (digitalPinToTouchChannel(p) >= 0) caps.add("touch");
#endif
#if SOC_RTCIO_PIN_COUNT > 0
  if (rtc_gpio_is_valid_gpio((gpio_num_t)p)) caps.add("rtc");
#endif

  o["strapping"] = inList(STRAPPING, p);
  o["reserved"] = pins[p].reserved;
  o["mode"] = modeName(pins[p].mode);
  if (pins[p].mode == GM_UNSET) o["level"] = nullptr;
  else o["level"] = digitalRead(p);
}

static void applyProfile() {
  for (auto &s : pins) {
    s.reserved = false;
    s.label = "";
  }
  for (int p = 0; p < SOC_GPIO_PIN_COUNT; p++) {
    if (inList(RESERVED, p)) pins[p].reserved = true;
    if (psramFound() && inList(RESERVED_PSRAM, p)) pins[p].reserved = true;
  }

  JsonDocument doc;
  if (deserializeJson(doc, prefs.getString("profile", "{}"))) return;
  for (int p : doc["release"].as<JsonArrayConst>())
    if (pinExists(p)) pins[p].reserved = false;
  for (int p : doc["reserve"].as<JsonArrayConst>())
    if (pinExists(p)) pins[p].reserved = true;
  for (JsonPairConst kv : doc["labels"].as<JsonObjectConst>()) {
    int p = atoi(kv.key().c_str());
    if (pinExists(p)) pins[p].label = kv.value() | "";
  }
}

static void setInput(int p, GpioMode m) {
  pinMode(p, m == GM_INPUT_PULLUP ? INPUT_PULLUP : m == GM_INPUT_PULLDOWN ? INPUT_PULLDOWN : INPUT);
  pins[p].mode = m;
}

static void setOutput(int p, int level) {
  if (level >= 0) gpio_set_level((gpio_num_t)p, level);       // preload to reduce the chance of a glitch
  pinMode(p, OUTPUT);
  gpio_set_direction((gpio_num_t)p, GPIO_MODE_INPUT_OUTPUT);  // lets digitalRead report the driven level
  pins[p].mode = GM_OUTPUT;
}

// ---- HTTP -----------------------------------------------------------------------
static void sendJson(int code, JsonDocument &doc) {
  String out;
  serializeJson(doc, out);
  server.send(code, "application/json", out);
}

static void sendError(int code, const char *msg) {
  JsonDocument doc;
  doc["error"] = msg;
  sendJson(code, doc);
}

static bool requireAuth() {
  if (apiToken.isEmpty() || server.header("Authorization") == "Bearer " + apiToken) return true;
  sendError(401, "unauthorised");
  return false;
}

static void handleList() {
  if (!requireAuth()) return;
  JsonDocument doc;
  doc["chip"] = ESP.getChipModel();
  doc["firmware"] = FW_VERSION;
  JsonArray arr = doc["pins"].to<JsonArray>();
  for (int p = 0; p < SOC_GPIO_PIN_COUNT; p++)
    if (pinExists(p)) pinToJson(p, arr.add<JsonObject>());
  sendJson(200, doc);
}

static void handleGetPin() {
  if (!requireAuth()) return;
  String arg = server.pathArg(0);
  char *end;
  long p = strtol(arg.c_str(), &end, 10);
  if (arg.isEmpty() || *end || !pinExists(p)) return sendError(404, "no such pin");
  JsonDocument doc;
  pinToJson(p, doc.to<JsonObject>());
  sendJson(200, doc);
}

static void handleSet() {
  if (!requireAuth()) return;
  JsonDocument doc;
  if (deserializeJson(doc, server.arg("plain"))) return sendError(400, "invalid JSON");
  if (!doc["pin"].is<int>()) return sendError(400, "'pin' must be an integer");
  int p = doc["pin"];
  if (!pinExists(p)) return sendError(404, "no such pin");
  if (pins[p].reserved) return sendError(409, "pin is reserved");

  JsonVariantConst modeArg = doc["mode"];
  JsonVariantConst levelArg = doc["level"];
  if (modeArg.isNull() && levelArg.isNull()) return sendError(400, "'mode' or 'level' required");

  GpioMode mode = GM_UNSET;
  if (!modeArg.isNull() && (mode = parseMode(modeArg)) == GM_UNSET)
    return sendError(400, "mode must be input, input_pullup, input_pulldown or output");
  int level = -1;
  if (!levelArg.isNull() && (level = parseLevel(levelArg)) < 0)
    return sendError(400, "level must be high/low, 1/0 or true/false");

  if (level >= 0 && mode != GM_UNSET && mode != GM_OUTPUT)
    return sendError(400, "level can only be set in output mode");
  if ((mode == GM_OUTPUT || level >= 0) && !pinCanOutput(p))
    return sendError(409, "pin is input-only");

  if (mode == GM_OUTPUT || (level >= 0 && pins[p].mode != GM_OUTPUT)) setOutput(p, level);
  else if (mode != GM_UNSET) setInput(p, mode);
  if (level >= 0) digitalWrite(p, level);

  JsonDocument res;
  pinToJson(p, res.to<JsonObject>());
  sendJson(200, res);
}

static void handleGetProfile() {
  if (!requireAuth()) return;
  server.send(200, "application/json", prefs.getString("profile", "{}"));
}

static void handlePutProfile() {
  if (!requireAuth()) return;
  String body = server.arg("plain");
  JsonDocument doc;
  if (deserializeJson(doc, body) || !doc.is<JsonObject>())
    return sendError(400, "profile must be a JSON object");
  prefs.putString("profile", body);
  applyProfile();
  handleList();
}

// ---- Main -----------------------------------------------------------------------
void setup() {
  Serial.begin(115200);
  prefs.begin("gpio-http", false);
  apiToken = prefs.getString("token", "");
  applyProfile();

  // Wi-Fi credentials and API token are set via a captive portal on first boot
  // (or whenever the saved network can't be reached).
  WiFiManager wm;
  WiFiManagerParameter tokenParam("token", "API token (blank = no auth)", apiToken.c_str(), 64);
  bool saved = false;
  wm.addParameter(&tokenParam);
  wm.setSaveConfigCallback([&saved]() { saved = true; });
  wm.setSaveParamsCallback([&saved]() { saved = true; });
  wm.setConfigPortalTimeout(300);
  String apName = "gpio-http-" + String((uint32_t)ESP.getEfuseMac(), HEX);
  if (!wm.autoConnect(apName.c_str())) ESP.restart();
  if (saved) {
    apiToken = tokenParam.getValue();
    prefs.putString("token", apiToken);
  }

  const char *headers[] = {"Authorization"};
  server.collectHeaders(headers, 1);
  server.on("/api/gpio", HTTP_GET, handleList);
  server.on("/api/gpio", HTTP_POST, handleSet);
  server.on(UriBraces("/api/gpio/{}"), HTTP_GET, handleGetPin);
  server.on("/api/profile", HTTP_GET, handleGetProfile);
  server.on("/api/profile", HTTP_PUT, handlePutProfile);
  server.onNotFound([]() { sendError(404, "not found"); });
  server.begin();

  Serial.printf("gpio-http %s on %s — http://%s/api/gpio\n",
                FW_VERSION, ESP.getChipModel(), WiFi.localIP().toString().c_str());
}

void loop() {
  server.handleClient();
}
